## drivers/graphics/Kconfig
```kconfig
# SPDX-License-Identifier: GPL-2.0
#
# graphics for desktop
#

config GRAPHICS
tristate "graphics"
depends on x86
default y if x86
help
  Desktop graphics
```

## graphics/Kconfig
```kconfig
# SPDX-License-Identifier: GPL-2.0
#
# graphics for desktop
#

config GRAPHICS
tristate "graphics"
default y
help
  Desktop graphics
```

## multimedia/Kconfig
```kconfig
# SPDX-License-Identifier: GPL-2.0
#
# Graphics/sound/input for desktop
#

config MULTIMEDIA
tristate "multimedia"
default y
help
  Graphics/sound/input for desktop
```
